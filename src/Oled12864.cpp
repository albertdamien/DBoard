/*
  Copyright (c) 2018 Damien ALBERT <damien@rouge-orange.fr>

  This library is free software; you can redistribute it and/or
  modify it under the terms of the GNU Lesser General Public
  License as published by the Free Software Foundation; either
  version 2.1 of the License, or (at your option) any later version.

  This library is distributed in the hope that it will be useful,
  but WITHOUT ANY WARRANTY; without even the implied warranty of
  MERCHANTABILITY or FITNESS FOR A PARTICULAR PURPOSE. See the GNU
  Lesser General Public License for more details.

  You should have received a copy of the GNU Lesser General Public
  License along with this library; if not, write to the Free Software
  Foundation, Inc., 51 Franklin St, Fifth Floor, Boston, MA 02110-1301 USA
*/

#include <Oled12864.h>
#include "Wire.h"

#define STATE_START 0
#define STATE_OFF   1
#define STATE_ON    2

// 8x8 Font ASCII 32 - 127 Implemented
// Users can modify this to support more characters(glyphs)
// BasicFont is placed in code memory.
const unsigned char BasicFont[][8] PROGMEM=
{
  {0x00,0x00,0x00,0x00,0x00,0x00,0x00,0x00}, // ' '
  {0x00,0x00,0x5F,0x00,0x00,0x00,0x00,0x00}, // !
  {0x00,0x00,0x07,0x00,0x07,0x00,0x00,0x00}, // "
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  {0x00,0x02,0x05,0x05,0x02,0x00,0x00,0x00} 
};

Oled12864::Oled12864() :
    m_state(STATE_START) {
    // nothing left to write here
} // constructor

void Oled12864::setup() {
    Wire.begin();
    wait(0);
} // setup

void Oled12864::run(byte _serv) {
    switch (m_state) {
        case STATE_START:
            sendCommand(OLED12864_DISPLAY_OFF);
            m_state = STATE_OFF;
            wait(5); 
            break;
        case STATE_OFF:
            sendCommand(OLED12864_DISPLAY_ON);
            m_state = STATE_ON;
            wait(5); 
            break;
        case STATE_ON:
            sendCommand(OLED12864_NORMAL_DISPLAY);
            event(EVENT_READY);
            break;
    }
} // run

void Oled12864::setNormalDisplay() {
    sendCommand(OLED12864_NORMAL_DISPLAY);
} // setNormalDisplay

void Oled12864::setInverseDisplay() {
    sendCommand(OLED12864_INVERSE_DISPLAY);
} // setInverseDisplay

void Oled12864::setPageMode() {
    m_addressingMode = OLED12864_PAGE_MODE;
    sendCommand(OLED12864_ADDRESSING_MODE);
    sendCommand(m_addressingMode);
} // setPageMode

void Oled12864::setHorizontalMode() {
    m_addressingMode = OLED12864_HORIZONTAL_MODE;
    sendCommand(OLED12864_ADDRESSING_MODE);
    sendCommand(m_addressingMode);
} // setHorizontalMode


void Oled12864::setTextXY(byte _row, byte _column) {
    sendCommand(0xB0 + _row);                           //set page address
    sendCommand(0x00 + (8 * _column & 0x0F));           //set column lower address
    sendCommand(0x10 + ((8 * _column >> 4) & 0x0F));    //set column higher address
} // setTextXY


void Oled12864::clearDisplay() {
    sendCommand(OLED12864_DISPLAY_OFF);   //display off
    for(byte j = 0; j < 8; j++) { 
        setTextXY(j, 0);    
        for(byte i = 0; i < 16; i++) putChar(' '); //clear all columns
    }
    sendCommand(OLED12864_DISPLAY_ON);    //display on
    setTextXY(0, 0);    
} // clearDisplay

void Oled12864::setBrightness(byte _brightness) {
   sendCommand(OLED12864_SET_BRIGHTNESS);
   sendCommand(_brightness);
} // setBrightness 


void Oled12864::putChar(byte _c) {
    if(_c < 32 || _c > 127) _c=' '; //Ignore non-printable ASCII characters. This can be modified for multilingual font.
    for(byte i = 0; i < 8; i++) sendData(pgm_read_byte(&BasicFont[_c-32][i])); //font array starts at 0, ASCII starts at 32. Hence the translation
} // putChar

void Oled12864::putString(const byte _string[]) {
    byte i = 0;
    while(_string[i]) putChar(_string[i++]);
} // putString


byte Oled12864::putNumber(long _number) {
    byte char_buffer[10]="";
    byte i = 0;
    byte f = 0;

    if (_number < 0) {
        f = 1;
        putChar('-');
        _number = -_number;
    } else if (_number == 0) {
        f = 1;
        putChar('0');
        return f;
    } 

    while (_number > 0) {
      char_buffer[i++] = _number % 10;
      _number /= 10;
    }
    f += i;
    for(; i > 0; i--) {
      putChar('0'+ char_buffer[i - 1]);
    }
    return f;
} // putNumber


byte Oled12864::putFloat(float _number, byte _decimal) {
    unsigned int temp = 0;
    float decy = 0.0;
    float rounding = 0.5;
    byte f = 0;
    if(_number < 0.0) {
        putString("-");
        _number = -_number;
        f += 1;
    }
    for (byte i = 0; i < _decimal; ++i) rounding /= 10.0;
    _number += rounding;
    
    temp = _number;
    f += putNumber(temp);
    if(_decimal > 0) {
      putChar('.');
      f += 1;
    }
    decy = _number - temp;//decimal part, 
    for(byte i = 0;i < _decimal; i++) { //4 
      decy *= 10; // for the next decimal
      temp = decy;//get the decimal
      putNumber(temp);
      decy -= temp;
    }
    f += _decimal;
    return f;
} // putFloat

byte Oled12864::putFloat(float _number) {
    return putFloat(_number, 2);
} // putFloat

void Oled12864::drawBitmap(byte *_bitmap,int _bytes) {
  byte localAddressMode = m_addressingMode;
  if (m_addressingMode != OLED12864_HORIZONTAL_MODE) setHorizontalMode();   // bitmap is drawn in horizontal mode
  for(int i = 0; i < _bytes; i++) sendData(pgm_read_byte(&_bitmap[i]));
  if (localAddressMode == OLED12864_PAGE_MODE) setPageMode();               // if pageMode was used earlier, restore it.
} // drawBitmap

void Oled12864::setScrollProperties(bool _direction, byte _startPage, byte _endPage, byte _scrollSpeed) {
    /*
    Use the following defines for 'direction' :

     Scroll_Left            
     Scroll_Right           

    Use the following defines for 'scrollSpeed' :

     Scroll_2Frames     
     Scroll_3Frames
     Scroll_4Frames
     Scroll_5Frames 
     Scroll_25Frames
     Scroll_64Frames
     Scroll_128Frames
     Scroll_256Frames

    */
    if(Scroll_Right == _direction) 
        sendCommand(OLED12864_RIGHT_SCROLL);
    else 
        sendCommand(OLED12864_LEFT_SCROLL);

    sendCommand(0x00);
    sendCommand(_startPage);
    sendCommand(_scrollSpeed);
    sendCommand(_endPage);
    sendCommand(0x00);
    sendCommand(0xFF);
} // setScrollProperties

void Oled12864::activateScroll() {
    sendCommand(OLED12864_ACTIVATE_SCROLL);
} // activateScroll

void Oled12864::deactivateScroll() {
    sendCommand(OLED12864_DEACTIVATE_SCROLL);
} // deactivateScroll

void Oled12864::sendCommand(byte _command) {
  Wire.beginTransmission(OLED12864_ADDRESS);
  Wire.write(OLED12864_COMMAND_MODE);
  Wire.write(_command);
  Wire.endTransmission();
} // sendCommand

void Oled12864::sendData(byte _data) {
     Wire.beginTransmission(OLED12864_ADDRESS);
     Wire.write(OLED12864_DATA_MODE);
     Wire.write(_data);
     Wire.endTransmission();
} // sendData